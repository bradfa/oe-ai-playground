## meta-bradfa-ai-distro/conf/distro/bradfa-container-distro.conf
```bitbake
DISTRO = "bradfa-container-distro"
DISTRO_NAME = "bradfa-container-distro"
DISTRO_VERSION = "1.0+snapshot-${METADATA_REVISION}"
DISTRO_CODENAME = "wrynose"

DISTRO_FEATURES = " \
    acl \
    ipv4 \
    ipv6 \
    minidebuginfo \
    seccomp \
    usrmerge \
    virtualization \
    xattr \
"

# We don't need an init in containers so setup the most minimal one possible
INIT_MANAGER = "mdev-busybox"
VIRTUAL-RUNTIME_init_manager = ""
VIRTUAL-RUNTIME_dev_manager = ""
VIRTUAL-RUNTIME_login_manager = ""
VIRTUAL-RUNTIME_initscripts = ""
VIRTUAL-RUNTIME_syslog = ""
VIRTUAL-RUNTIME_sysklogd = ""
VIRTUAL-RUNTIME_base-utils-syslog = ""
```

## meta-bradfa-ai-distro/conf/layer.conf
```bitbake
# We have a conf and classes directory, add to BBPATH
BBPATH .= ":${LAYERDIR}"

# We have recipes-* directories, add to BBFILES
BBFILES += "${LAYERDIR}/recipes-*/*/*.bb \
            ${LAYERDIR}/recipes-*/*/*.bbappend"

BBFILE_COLLECTIONS += "meta-bradfa-ai-distro"
BBFILE_PATTERN_meta-bradfa-ai-distro = "^${LAYERDIR}/"
BBFILE_PRIORITY_meta-bradfa-ai-distro = "6"

LAYERDEPENDS_meta-bradfa-ai-distro = "core"
LAYERSERIES_COMPAT_meta-bradfa-ai-distro = "wrynose"
```
